/ {
    chosen {
        zmk,display = &oled;
    };
};

&pro_micro_i2c {
    status = "okay";

    oled: ssd1306@3c {
        compatible = "solomon,ssd1306fb";
        reg = <0x3c>;
        width = <128>;
        height = <64>;        /* <--- Wymuszenie 64 pikseli wysokości */
        segment-remap;
        page-offset = <0>;
        display-offset = <0>;
        multiplex-ratio = <63>; /* <--- Ważne dla ekranów 64px */
        prechargep = <0x22>;
    };
};	
