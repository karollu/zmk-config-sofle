## boards/shields/my_sofle/Kconfig.shield
```kconfig
# Copyright (c) 2020 Ryan Cross
# SPDX-License-Identifier: MIT

config SHIELD_MY_SOFLE_LEFT
    def_bool $(shields_list_contains,my_sofle_left)

config SHIELD_MY_SOFLE_RIGHT
    def_bool $(shields_list_contains,my_sofle_right)
```
